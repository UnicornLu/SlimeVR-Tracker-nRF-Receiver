## boards/aerorx/aerorx_r1/board.yml
```yaml
# Copyright (c) 2024 Nordic Semiconductor ASA
# SPDX-License-Identifier: Apache-2.0

board:
  name: aerorx_r1_uf2
  full_name: AeroRX R1
  vendor: aerorx
  socs:
    - name: nrf52840
```

## boards/crazt/sk_cheesecake_recv33/Kconfig.sk_cheesecake_recv33
```kconfig
# Copyright (c) 2026
# SPDX-License-Identifier: Apache-2.0

config BOARD_SK_CHEESECAKE_RECV33
	select SOC_NRF52833_QIAA
```

## boards/crazt/sk_cheesecake_recv33/board.yml
```yaml
# Copyright (c) 2026
# SPDX-License-Identifier: Apache-2.0

board:
  name: sk_cheesecake_recv33
  full_name: SK Cheesecake Receiver 33
  vendor: crazt
  socs:
    - name: nrf52833
      variants:
        - name: uf2
```

## boards/crazt/sk_cheesecake_recv33/sk_cheesecake_recv33_nrf52833_uf2_defconfig
```kconfig
# Copyright (c) 2026
# SPDX-License-Identifier: Apache-2.0

CONFIG_ARM_MPU=y
CONFIG_HW_STACK_PROTECTION=y
CONFIG_GPIO=y
CONFIG_SPI=y
CONFIG_LED_STRIP=y
CONFIG_WS2812_STRIP_SPI=y
CONFIG_LED_RGB_COLOR=y
CONFIG_USB_DEVICE_REMOTE_WAKEUP=n

CONFIG_SLIMEVR_USB_DEVICE_MANUFACTURER="Crazt"
CONFIG_SLIMEVR_USB_DEVICE_PRODUCT="SlimeNRF Receiver SK Cheesecake RECV33"

CONFIG_MPSL=y
CONFIG_MPSL_FEM=y
CONFIG_MPSL_FEM_SIMPLE_GPIO=y
CONFIG_RADIO_TX_POWER=30

CONFIG_BUILD_OUTPUT_UF2=y
CONFIG_BUILD_OUTPUT_UF2_FAMILY_ID="0x621e937a"
```

## boards/foxapplication/foxdongle33_uf2/board.yml
```yaml
# Copyright (c) 2024 Nordic Semiconductor ASA
# SPDX-License-Identifier: Apache-2.0

board:
  name: foxdongle33_uf2
  full_name: FoxApplication Receiver FoxDongle33
  vendor: foxapplication
  socs:
    - name: nrf52833
```

## boards/foxapplication/foxdongle_uf2/board.yml
```yaml
# Copyright (c) 2024 Nordic Semiconductor ASA
# SPDX-License-Identifier: Apache-2.0

board:
  name: foxdongle_uf2
  full_name: FoxApplication Receiver FoxDongle
  vendor: foxapplication
  socs:
    - name: nrf52840
```

## boards/hulimiao/nekonya/board.yml
```yaml
# Copyright (c) 2024 Nordic Semiconductor ASA
# SPDX-License-Identifier: Apache-2.0

board:
  name: nekonya_uf2
  full_name: NekoNya
  vendor: hulimiao
  socs:
    - name: nrf52833
```

## boards/nini_slimevr/nini_slimevr/board.yml
```yaml
# Copyright (c) 2026
# SPDX-License-Identifier: Apache-2.0

board:
  name: nini_slimevr_uf2
  full_name: NiNi SlimeVR Receiver
  vendor: nini_slimevr
  socs:
    - name: nrf52833
```

## boards/slimevr/nini_slimevr/board.yml
```yaml
# Copyright (c) 2026
# SPDX-License-Identifier: Apache-2.0

board:
  name: nini_slimevr_uf2
  vendor: slimevr
  socs:
    - name: nrf52833
```

## boards/slimevr/nini_slimevr/nini_slimevr_uf2_defconfig
```kconfig
# Copyright (c) 2026
# SPDX-License-Identifier: Apache-2.0

CONFIG_ARM_MPU=y
CONFIG_HW_STACK_PROTECTION=y

CONFIG_USB_DEVICE_STACK=y
CONFIG_USB_DEVICE_MANUFACTURER="SlimeVR"
CONFIG_USB_DEVICE_PRODUCT="SlimeNRF Receiver Nini SlimeVR"

CONFIG_MPSL=y
CONFIG_MPSL_FEM=y
CONFIG_MPSL_FEM_SIMPLE_GPIO=y
CONFIG_MPSL_FEM_GENERIC_TWO_CTRL_PINS_SUPPORT=y

CONFIG_SPI=y
CONFIG_LED_STRIP=y
CONFIG_WS2812_STRIP=y
CONFIG_LED_RGB_COLOR=y
CONFIG_LED_DEFAULT_COLOR_R=4000
CONFIG_LED_DEFAULT_COLOR_G=6000
CONFIG_LED_DEFAULT_COLOR_B=0

# generate for adafruit uf2 bootloader flashing
CONFIG_BUILD_OUTPUT_UF2=y
CONFIG_FLASH_LOAD_OFFSET=0x1000
```

## boards/styria/styria_r1/board.yml
```yaml
# Copyright (c) 2024 Nordic Semiconductor ASA
# SPDX-License-Identifier: Apache-2.0

board:
  name: styria_r1_uf2
  full_name: Styria R1
  vendor: styria
  socs:
    - name: nrf52840
```
