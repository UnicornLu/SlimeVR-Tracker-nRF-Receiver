// Copyright (c) 2024 Nordic Semiconductor ASA
// SPDX-License-Identifier: Apache-2.0

/dts-v1/;
#include <nordic/nrf52833_qdaa.dtsi>

/ {
	model = "nini_slimevr_diversity_uf2";
	compatible = "nini_slimevr_diversity_uf2";

	chosen {
		zephyr,sram = &sram0;
		zephyr,flash = &flash0;
		zephyr,console = &cdc_acm_uart0;
		zephyr,shell-uart = &cdc_acm_uart0;
	};

	nrf_radio_fem: se2431_fem {
		compatible = "skyworks,se2431", "generic-fem-two-ctrl-pins";
		ctx-gpios = <&gpio0 30 GPIO_ACTIVE_HIGH>;  /* TXEN */
		ctx-settle-time-us = <23>;
		crx-gpios = <&gpio0 29 GPIO_ACTIVE_HIGH>;  /* RXEN */
		crx-settle-time-us = <8>;
		tx-gain-db = <20>;
		rx-gain-db = <12>;
	};

	buttons {
        compatible = "gpio-keys";
        button0: button_0 {
            gpios = <&gpio0 13 (GPIO_PULL_UP | GPIO_ACTIVE_LOW)>;
            label = "Push button switch 0";
            zephyr,code = <INPUT_KEY_0>;
        };
    };
	
    aliases {
        sw0 = &button0;
        led0 = &led0_blue;
        led1 = &led1_red;
        led0-blue = &led0_blue;
        led1-red   = &led1_red;
        pwm-led0 = &blue_pwm_led;
        blue-pwm-led = &blue_pwm_led;
        watchdog0 = &wdt0;
    };
};

	zephyr,user {
		led-gpios = <&gpio0 4 GPIO_OPEN_SOURCE>;
		ant-set-gpios = <&gpio0 28 GPIO_ACTIVE_HIGH>;
		csd-gpios = <&gpio0 2 GPIO_ACTIVE_HIGH>;
	};
};

&reg0 {
    status = "disabled";
};

&reg1 {
	regulator-initial-mode = <NRF5X_REG_MODE_DCDC>;
};

&gpio0 {
	status = "okay";
};

&gpiote {
	status = "okay";
};

zephyr_udc0: &usbd {
	compatible = "nordic,nrf-usbd";
	status = "okay";
	cdc_acm_uart0: cdc_acm_uart0 {
		compatible = "zephyr,cdc-acm-uart";
	};
};

&nfct {
	status = "disabled";
};

&radio {
	fem = <&nrf_radio_fem>;
};

&cryptocell {
    status = "disabled";
};

&ieee802154 {
    status = "okay";
};

