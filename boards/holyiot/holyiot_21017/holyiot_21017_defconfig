## boards/holyiot/holyiot_21017/holyiot_21017_defconfig
```kconfig
# Copyright (c) 2024 Nordic Semiconductor ASA
# SPDX-License-Identifier: Apache-2.0

CONFIG_ARM_MPU=y
CONFIG_HW_STACK_PROTECTION=y
CONFIG_GPIO=y

CONFIG_SLIMEVR_USB_DEVICE_MANUFACTURER="Holyiot"
CONFIG_SLIMEVR_USB_DEVICE_PRODUCT="SlimeNRF Receiver Holyiot-21017"

CONFIG_LED_RGB_COLOR=y

CONFIG_USE_SEGGER_RTT=y
CONFIG_RTT_CONSOLE=y
CONFIG_LOG_BACKEND_RTT=y

CONFIG_MPSL=y
CONFIG_MPSL_FEM=y
CONFIG_MPSL_FEM_SIMPLE_GPIO=y

CONFIG_RADIO_TX_POWER=30
CONFIG_MPSL_FEM_GENERIC_TWO_CTRL_PINS_SUPPORT=y
```

## boards/nrf52840dongle_nrf52840.conf
```kconfig
CONFIG_SLIMEVR_USB_DEVICE_MANUFACTURER="Nordic Semiconductor"
CONFIG_SLIMEVR_USB_DEVICE_PRODUCT="SlimeNRF Receiver nRF52840 Dongle"

CONFIG_LED_RGB_COLOR=y
```

## boards/xiao_ble.conf
```kconfig
CONFIG_SLIMEVR_USB_DEVICE_MANUFACTURER="Seeed Studio"
CONFIG_SLIMEVR_USB_DEVICE_PRODUCT="SlimeNRF Receiver XIAO"

CONFIG_LED_RGB_COLOR=y
```
